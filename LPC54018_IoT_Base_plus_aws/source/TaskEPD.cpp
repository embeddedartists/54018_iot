
/* FreeRTOS kernel includes. */
#include "FreeRTOS.h"
#include "task.h"
#include "queue.h"
#include "timers.h"
#include "semphr.h"

/*  SDK Included Files */
#include "board.h"

#include "Pervasive_EPD_BoosterPack2.h"
#include "Screen_EPD.h"
#include "expansion.h"
#include "data_store.h"

/*******************************************************************************
 * Definitions
 ******************************************************************************/

#define bar1x 192
#define bar1y 140
#define bar2x 238
#define bar2y 140
#define bar3x 275
#define bar3y 140

/*******************************************************************************
 * Prototypes
 ******************************************************************************/

#define delay(__ms)  vTaskDelay((__ms) / portTICK_PERIOD_MS)

/*******************************************************************************
 * Variables
 ******************************************************************************/

static Screen_EPD* myScreen = NULL;

static data_store_t message;

static const uint8_t img_NXP[] = {
//Image Name: NXP-solid-long.jpg ; Width: 104 ; Height: 35
0xff,0xff,0xff,0xff,0xff,0xff,0xff,0xff,0xff,0xff,0xff,0xff,0xff, // 1
0xe0,0x07,0xff,0xff,0xc0,0x03,0xff,0xf0,0x00,0xe0,0x00,0x07,0xff, // 2
0xe0,0x03,0xff,0xfe,0xc0,0x01,0xff,0xe0,0x00,0xc0,0x00,0x00,0x7f, // 3
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0xe0,0x07,0xff,0xfd,0xc0,0x03,0xff,0xf0,0x00,0xdf,0xff,0xff,0xff, // 35
};

//static uint32_t img_NXP_sz = sizeof(img_NXP)/sizeof(img_NXP[0]);


static const uint8_t img_EA_bw[] = {
//Image Name: EmbeddedArtists_bw_104_64_bw.png ; Width: 104 ; Height: 64
0xff,0xff,0xff,0xff,0xff,0xff,0xff,0xff,0xff,0xff,0xff,0xff,0xff, // 1
0xff,0xff,0xff,0xff,0xff,0xff,0xff,0xff,0xff,0xff,0xff,0xff,0xff, // 2
0xff,0xff,0xff,0xff,0xff,0xff,0xff,0xff,0xff,0xff,0xff,0xff,0xff, // 3
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0xff,0xff,0xff,0xff,0xff,0xff,0xff,0xff,0xff,0xff,0xff,0xff,0xff, // 64
};

static const uint8_t img_EA_red[] = {
//static uint32_t img_EA_sz = sizeof(img_EA)/sizeof(img_EA[0]);
//Image Name: EmbeddedArtists_bw_104_64_red.png ; Width: 104 ; Height: 64
0xff,0xff,0xff,0xff,0xff,0xff,0xff,0xff,0xff,0xff,0xff,0xff,0xff, // 1
0xff,0xff,0xff,0xff,0xff,0xff,0xff,0xff,0xff,0xff,0xff,0xff,0xff, // 2
0xff,0xff,0xff,0xff,0xff,0xff,0xff,0xff,0xff,0xff,0xff,0xff,0xff, // 3
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0xff,0xff,0xff,0xff,0xff,0xff,0xff,0xff,0xff,0xff,0xff,0xff,0xff, // 64
};


/*******************************************************************************
 * Code
 ******************************************************************************/

static void displayEPD(int tmp_t, int tmp_p, int tmp_h)
{
    static int rndCnt = 0;
    int height;
    int textStartY = 0;

    myScreen->begin();
    myScreen->setOrientation(3);
    myScreen->setFontSolid(false);
    myScreen->setFontSize(1);
    
    //Temperature
    myScreen->setFontSize(0);
    myScreen->gText(bar1x-18,bar1y-96-20, formatString("Temp"));
    myScreen->gText(bar1x-18,bar1y-96-12, formatString("(C)"));
    myScreen->setFontSize(1);
    myScreen->gText(bar1x-18,bar1y-98,    formatString("%i.%i", (tmp_t+4)/10,(tmp_t+4)%10), redColour, whiteColour);
    myScreen->setFontSize(0);
    myScreen->gText(bar1x-18,bar1y-80-4, formatString("30"));
    myScreen->gText(bar1x-18,bar1y-40-4, formatString("20"));
    myScreen->gText(bar1x-18,bar1y-4,    formatString("10"));
    myScreen->setPenSolid(false);
    myScreen->dRectangle(bar1x,bar1y-80, 15, 80, blackColour);
    myScreen->line(bar1x-4,bar1y-80, bar1x, bar1y-80, blackColour);
    myScreen->line(bar1x-2,bar1y-76, bar1x, bar1y-76, blackColour);
    myScreen->line(bar1x-2,bar1y-72, bar1x, bar1y-72, blackColour);
    myScreen->line(bar1x-2,bar1y-68, bar1x, bar1y-68, blackColour);
    myScreen->line(bar1x-2,bar1y-64, bar1x, bar1y-64, blackColour);
    myScreen->line(bar1x-4,bar1y-60, bar1x, bar1y-60, blackColour);
    myScreen->line(bar1x-2,bar1y-56, bar1x, bar1y-56, blackColour);
    myScreen->line(bar1x-2,bar1y-52, bar1x, bar1y-52, blackColour);
    myScreen->line(bar1x-2,bar1y-48, bar1x, bar1y-48, blackColour);
    myScreen->line(bar1x-2,bar1y-44, bar1x, bar1y-44, blackColour);
    myScreen->line(bar1x-4,bar1y-40, bar1x, bar1y-40, blackColour);
    myScreen->line(bar1x-2,bar1y-36, bar1x, bar1y-36, blackColour);
    myScreen->line(bar1x-2,bar1y-32, bar1x, bar1y-32, blackColour);
    myScreen->line(bar1x-2,bar1y-28, bar1x, bar1y-28, blackColour);
    myScreen->line(bar1x-2,bar1y-24, bar1x, bar1y-24, blackColour);
    myScreen->line(bar1x-4,bar1y-20, bar1x, bar1y-20, blackColour);
    myScreen->line(bar1x-2,bar1y-16, bar1x, bar1y-16, blackColour);
    myScreen->line(bar1x-2,bar1y-12, bar1x, bar1y-12, blackColour);
    myScreen->line(bar1x-2,bar1y-8,  bar1x, bar1y-8,  blackColour);
    myScreen->line(bar1x-2,bar1y-4,  bar1x, bar1y-4,  blackColour);
    myScreen->line(bar1x-4,bar1y,    bar1x, bar1y,    blackColour);
    myScreen->setPenSolid(true);
    height = 4*(((tmp_t+4)/10) - 10);
    if (height > 80) height = 80;
    if (height < 0) height = 0;
    myScreen->dRectangle(bar1x+1,bar1y-height, 14, height, redColour);
    
    //Pressure
    myScreen->setFontSize(0);
    myScreen->gText(bar2x-18,bar2y-96-20, formatString("Press"));
    myScreen->gText(bar2x-18,bar2y-96-12, formatString("(pA)"));
    myScreen->setFontSize(1);
    myScreen->gText(bar2x-18,bar2y-98, formatString("%i", tmp_p), redColour, whiteColour);
    myScreen->setFontSize(0);
    myScreen->gText(bar2x-30,bar2y-80-4, formatString("1200"));
    myScreen->gText(bar2x-30,bar2y-40-4, formatString("1100"));
    myScreen->gText(bar2x-30,bar3y-4, formatString("1000"));
    myScreen->setPenSolid(false);
    myScreen->dRectangle(bar2x,bar2y-80, 15, 80, blackColour);
    myScreen->line(bar2x-4,bar2y-80, bar2x, bar2y-80, blackColour);
    myScreen->line(bar2x-2,bar2y-60, bar2x, bar2y-60, blackColour);;
    myScreen->line(bar2x-4,bar2y-40, bar2x, bar2y-40, blackColour);
    myScreen->line(bar2x-2,bar2y-20, bar2x, bar2y-20, blackColour);
    myScreen->line(bar2x-4,bar2y-0,  bar2x, bar2y-0, blackColour);
    myScreen->setPenSolid(true);
    height = 2*((tmp_p-1000)/5);
    if (height > 80) height = 80;
    if (height < 0) height = 0;
    myScreen->dRectangle(bar2x+1,bar2y-height, 14, height, redColour);
    
    //Humidity
    myScreen->setFontSize(0);
    myScreen->gText(bar3x-18,bar3y-96-20, formatString("Humidi"));
    myScreen->gText(bar3x-18,bar3y-96-12, formatString("(Rf)"));
    myScreen->setFontSize(1);
    myScreen->gText(bar3x-18,bar3y-98, formatString("%i.%i", (tmp_h+4)/10,(tmp_h+4)%10), redColour, whiteColour);
    myScreen->setFontSize(0);
    myScreen->gText(bar3x-18,bar3y-80-4, formatString("90"));
    myScreen->gText(bar3x-18,bar3y-40-4, formatString("50"));
    myScreen->gText(bar3x-18,bar3y-4, formatString("10"));
    myScreen->setPenSolid(false);
    myScreen->dRectangle(bar3x,bar3y-80, 15, 80, blackColour);
    myScreen->line(bar3x-4,bar3y-80, bar3x, bar3y-80, blackColour);
    myScreen->line(bar3x-4,bar3y-70, bar3x, bar3y-70, blackColour);
    myScreen->line(bar3x-4,bar3y-60, bar3x, bar3y-60, blackColour);
    myScreen->line(bar3x-4,bar3y-50, bar3x, bar3y-50, blackColour);
    myScreen->line(bar3x-4,bar3y-40, bar3x, bar3y-40, blackColour);
    myScreen->line(bar3x-4,bar3y-30, bar3x, bar3y-30, blackColour);
    myScreen->line(bar3x-4,bar3y-20, bar3x, bar3y-20, blackColour);
    myScreen->line(bar3x-4,bar3y-10, bar3x, bar3y-10, blackColour);
    myScreen->line(bar3x-4,bar3y-0,  bar3x, bar3y-0, blackColour);
    myScreen->setPenSolid(true);
    height = (((tmp_h+4)/10) - 10);
    if (height > 80) height = 80;
    if (height < 0) height = 0;
    myScreen->dRectangle(bar3x+1,bar3y-height, 14, height, redColour);
    
    //Weather text
    myScreen->setFontSize(2);
    myScreen->gText(194, 5, formatString("Weather"));
    
    rndCnt++;
    if (rndCnt >= 3)
    rndCnt = 0;
    
    if (rndCnt == 0)
    {
        //Copy NXP's logo on back
        myScreen->displayImage(20,8,104,35,blackColour,whiteColour,img_NXP);
        textStartY=55;
    }
    else if (rndCnt == 1)
    {
        //Copy NXP's logo in red
        myScreen->displayImage(20,8,104,35,redColour,whiteColour,img_NXP);
        textStartY=55;
    }
    else if (rndCnt == 2)
    {
        //Copy EA's logo
        myScreen->displayImage(20,0,104,64,redColour,whiteColour,img_EA_red);
        myScreen->displayImage(20,0,104,64,blackColour,greenColour,img_EA_bw); //greenColour = transparent
        textStartY=63;
    }
    
    //General text
    myScreen->setFontSize(2);
    myScreen->gText(3,textStartY, formatString("LPC54018 IoT"));
    myScreen->line(3, textStartY+16, 146, textStartY+16, blackColour);
    myScreen->line(3, textStartY+17, 146, textStartY+17, blackColour);
    myScreen->setFontSize(1);
    myScreen->gText(3,textStartY+20, formatString("Cortex-M4 @ 180MHz"));
    myScreen->gText(3,textStartY+20+13, formatString("360 KB SRAM"));
    myScreen->gText(3,textStartY+20+13+13, formatString("16 MB QSPI"));
    myScreen->gText(3,textStartY+20+13+13+13, formatString("Wi-Fi IEEE802.11b/g/n"));
    myScreen->gText(3,textStartY+20+13+13+13+13, formatString(message.msg));
    
    //Border
    myScreen->setPenSolid(false);
    myScreen->dRectangle(0, 0, myScreen->screenSizeX(), myScreen->screenSizeY(), blackColour);
    
    myScreen->flush();
}

static void epd_task_entry(void* args)
{
	float t = 0, p = 0, h = 0;
    EventBits_t event_bits;
	EventGroupHandle_t event_group = ds_subscribe();
	if (event_group == NULL) {
		configPRINTF(("Failed to subscribe to Data Store\r\n"));
		vTaskDelete(NULL);
		return;
	}
	if (!ds_read(&message)) {
		configPRINTF(("Failed to read initial message\r\n"));
		vTaskDelete(NULL);
		return;
	}

	myScreen = new Screen_EPD(eScreen_EPD_iTC_266_BWR);
	while (true) {
		event_bits = xEventGroupWaitBits(event_group,    /* The event group handle. */
						DS_MSG_CHANGED | DS_BUTTON_CHANGED,    /* The bit pattern the event group is waiting for. */
						pdTRUE,         /* The event bits will be cleared automatically. */
						pdFALSE,        /* Don't wait for both bits, either bit unblock task. */
						portMAX_DELAY); /* Block indefinitely to wait for the condition to be met. */

		if ((event_bits & (DS_MSG_CHANGED | DS_BUTTON_CHANGED)) > 0)
		{
			ds_read(&message);
			if ((event_bits & DS_MSG_CHANGED) == DS_MSG_CHANGED)
			{
				configPRINTF(("Got a new message. '%s'\r\n", message.msg));
			}
			else if ((event_bits & DS_BUTTON_CHANGED) == DS_BUTTON_CHANGED)
			{
				if (!message.button_pressed) {
					/* This event is because the button was released.
					 * No need to redraw the display again.
					 */
					continue;
				}
			}
		}

		configPRINTF(("Started updating ePaper\r\n"));
		displayEPD(t*10, p, h*10);
		configPRINTF(("Finished updating ePaper\r\n"));
	}
}

#if defined(__cplusplus)
extern "C" {
#endif

int display_task_prepare(void)
{
	TaskHandle_t xCreatedTask;
	if (xTaskCreate(epd_task_entry,                  /* pointer to the task */
					"epd",                           /* task name for kernel awareness debugging */
					EXPANSION_TASK_DEFAULT_STACK,    /* task stack size */
					NULL,                            /* optional task startup argument */
					tskIDLE_PRIORITY + 1,     /* initial priority */
					&xCreatedTask                    /* optional task handle to create */
					) != pdPASS)
	{
		return -1;
	}
	return 0;
}

#if defined(__cplusplus)
}
#endif
